
#include "bsp_oled.h"

#include <string.h>

/* ====== 软件模拟 I2C ======
 *
 * 不用 STM32 的 I2C1 外设, 把两根普通 GPIO 当 I2C 用, 自己拉时序:
 *   SCL(PB3): 推挽输出 —— 总线上只有主机驱动它, 推挽不会冲突
 *   SDA(PB4): 平时推挽输出, 读应答的第 9 个时钟切成输入上拉松开总线
 *
 * 为什么用推挽而不是开漏:
 *   开漏只能把线拉低, 高电平全靠外部上拉。早期用硬件 I2C1(开漏)时高电平只到
 *   1.82V 左右, 低于 SSD1306 认高的门槛(0.7*VDD 约 2.3V), 从机认不出高电平
 *   (那 1.82V 是屏的上拉偏弱, 还是当时就挂在已损坏的 PB8/PB9 上, 没分开验证过)。
 *   推挽由 CPU 直接把线顶到 3.3V, 不受上拉强弱影响。
 *
 * 为什么不用硬件 I2C1:
 *   I2C1 的两组脚位都不可用 —— 默认的 PB6/PB7 是右编码器(TIM4),
 *   重映射的 PB8/PB9 推挽顶高只有零点几伏(损坏)。I2C2 的 PB10/PB11
 *   是电机方向脚。硬件 I2C 在这块板子上没有落点。
 *
 * 注意: 推挽驱动 + 主机独占, 只适合点对点。要往这条总线上再挂一个从机
 *   (比如 MPU6050), 得先把 SCL/SDA 改成开漏并配合适的外部上拉, 否则从机
 *   拉低 SDA/SCL 时主机的推挽驱动器会跟它顶牛。
 */

/* ---- 引脚选择: 换脚只改下面这几行 ----
 *
 * PB3/PB4 出厂是 JTAG 的 JTDO / NJTRST, 但 HAL_MspInit() 已调过
 * __HAL_AFIO_REMAP_SWJ_NOJTAG(): JTAG 关掉、SWD 保留, 当普通 GPIO 没问题,
 * ST-Link 的下载和调试都不受影响。
 *
 * POS 的计算: PBn 占 bit(4n+3 : 4n), 即 POS = 4*n, 这是"绝对"位置 ——
 * I2C_PinCfg 会自己按 POS 是否 >= 32 选 CRL 还是 CRH。
 *   PB3 -> POS 12, PB4 -> POS 16   (都落在 CRL)
 *   PB8 -> POS 32, PB9 -> POS 36   (都落在 CRH; 别写成 0 / 4, 那是 PB0 / PB1)
 */
#define I2C_PORT            GPIOB
#define I2C_SCL_PIN         GPIO_PIN_3
#define I2C_SDA_PIN         GPIO_PIN_4
#define I2C_SCL_POS         12
#define I2C_SDA_POS         16

/* 半周期延时(空循环), 量级几微秒。SSD1306 只限最高 400kHz, 慢一点无所谓 */
#define I2C_DELAY()         do { for (volatile uint32_t d = 0; d < 40; d++) { } } while (0)

/* I2C 写控制字节: 0x00=命令, 0x40=数据 (SSD1306 在 I2C 下的 D/C# 位置) */
#define OLED_CTRL_CMD       0x00
#define OLED_CTRL_DATA      0x40

/* 从机不应答的累计次数. 屏没接/没上电时它只涨, 是"屏在不在线"的唯一信号 */
uint32_t g_i2c_nack_count = 0;

/*
 * 把某个引脚在 CRL/CRH 里的 nibble 改成 cfg: 0x3=推挽输出, 0x8=输入上拉.
 * pos 是"绝对位域起点"(PBn -> 4*n): 0~31 落在 CRL, 32~63 落在 CRH。
 */
static void I2C_PinCfg(uint32_t pos, uint32_t cfg)
{
    volatile uint32_t *cr;
    uint32_t shift;

    if (pos < 32)
    {
        cr = &I2C_PORT->CRL;
        shift = pos;
    }
    else
    {
        cr = &I2C_PORT->CRH;
        shift = pos - 32;
    }

    *cr = (*cr & ~(0xFUL << shift)) | (cfg << shift);
}

/* 把两根线配成普通推挽输出, 并置为总线空闲(两根都是高) */
static void I2C_Bus_Init(void)
{
    GPIO_InitTypeDef GPIO_InitStruct = {0};

    __HAL_RCC_GPIOB_CLK_ENABLE();

    GPIO_InitStruct.Pin = I2C_SCL_PIN | I2C_SDA_PIN;
    GPIO_InitStruct.Mode = GPIO_MODE_OUTPUT_PP;
    GPIO_InitStruct.Speed = GPIO_SPEED_FREQ_HIGH;
    HAL_GPIO_Init(I2C_PORT, &GPIO_InitStruct);

    HAL_GPIO_WritePin(I2C_PORT, I2C_SCL_PIN | I2C_SDA_PIN, GPIO_PIN_SET);
}

/* SDA 切成输入上拉: 松开总线, 让从机可以把它拉低(应答) */
static void I2C_SdaInput(void)
{
    I2C_PinCfg(I2C_SDA_POS, 0x8);
    I2C_PORT->BSRR = I2C_SDA_PIN;   /* ODR=1 选中上拉 */
}

/* SDA 切回推挽输出 */
static void I2C_SdaOutput(void)
{
    I2C_PinCfg(I2C_SDA_POS, 0x3);
}

/* 起始条件: SCL 高时 SDA 由高变低 */
static void I2C_Start(void)
{
    HAL_GPIO_WritePin(I2C_PORT, I2C_SDA_PIN, GPIO_PIN_SET);
    HAL_GPIO_WritePin(I2C_PORT, I2C_SCL_PIN, GPIO_PIN_SET);
    I2C_DELAY();
    HAL_GPIO_WritePin(I2C_PORT, I2C_SDA_PIN, GPIO_PIN_RESET);
    I2C_DELAY();
    HAL_GPIO_WritePin(I2C_PORT, I2C_SCL_PIN, GPIO_PIN_RESET);
    I2C_DELAY();
}

/* 停止条件: SCL 高时 SDA 由低变高 */
static void I2C_Stop(void)
{
    HAL_GPIO_WritePin(I2C_PORT, I2C_SDA_PIN, GPIO_PIN_RESET);
    HAL_GPIO_WritePin(I2C_PORT, I2C_SCL_PIN, GPIO_PIN_SET);
    I2C_DELAY();
    HAL_GPIO_WritePin(I2C_PORT, I2C_SDA_PIN, GPIO_PIN_SET);
    I2C_DELAY();
}

/* 写一个字节(高位先出), 顺带统计从机不应答的次数 */
static uint8_t I2C_WriteByte(uint8_t byte)
{
    uint8_t ack;

    for (uint8_t i = 0; i < 8; i++)
    {
        HAL_GPIO_WritePin(I2C_PORT, I2C_SCL_PIN, GPIO_PIN_RESET);
        if ((byte & 0x80) != 0)
        {
            HAL_GPIO_WritePin(I2C_PORT, I2C_SDA_PIN, GPIO_PIN_SET);
        }
        else
        {
            HAL_GPIO_WritePin(I2C_PORT, I2C_SDA_PIN, GPIO_PIN_RESET);
        }
        byte = (uint8_t)(byte << 1);
        I2C_DELAY();
        HAL_GPIO_WritePin(I2C_PORT, I2C_SCL_PIN, GPIO_PIN_SET);
        I2C_DELAY();
    }

    /* 第 9 个时钟: 松开 SDA, 读从机有没有把它拉低 */
    HAL_GPIO_WritePin(I2C_PORT, I2C_SCL_PIN, GPIO_PIN_RESET);
    I2C_SdaInput();
    I2C_DELAY();
    HAL_GPIO_WritePin(I2C_PORT, I2C_SCL_PIN, GPIO_PIN_SET);
    I2C_DELAY();

    ack = (HAL_GPIO_ReadPin(I2C_PORT, I2C_SDA_PIN) == GPIO_PIN_RESET) ? 1 : 0;

    HAL_GPIO_WritePin(I2C_PORT, I2C_SCL_PIN, GPIO_PIN_RESET);
    I2C_SdaOutput();

    if (ack == 0)
    {
        g_i2c_nack_count++;
    }
    return ack;
}

/* ====== SSD1306 初始化命令序列 ====== */
static const uint8_t OLED_INIT_CMDS[] = {
    0xAE,             /* 关闭显示 */
    0xD5, 0x80,       /* 显示时钟分频 */
    0xA8, 0x3F,       /* 复用率: 1/64 */
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    0xAF,             /* 开启显示 */
};

/* ====== 8x16 ASCII 字模表 ======
 * 下标 = ASCII - 0x20 (即空格为0, '0'=0x30-0x20=16)。
 * 每个字符16字节: 前8字节=上半页(行0~7), 后8字节=下半页(行8~15)。
 * 每字节=一列(8像素), bit0=该页顶部行。
 *
 * 字形取自经典 VGA 8x16 点阵(IBM VGA BIOS ROM 的字符发生器字模, 各平台控制台
 * 字体通用的就是这一套), 原始数据是"行优先、bit7=最左", 已按上面的格式转成
 * "逐列、bit0=顶行"。字形只占中间第 2~11 行, 上留 2 行、下留 4 行 —— 这样 4 行
 * 文本之间才有行距, 不会贴成一整块。
 */
static const uint8_t FONT_8x16[][16] = {
    {0x00,0x00,0x00,0x00,0x00,0x00,0x00,0x00,0x00,0x00,0x00,0x00,0x00,0x00,0x00,0x00},  /* SP */
    {0x00,0x00,0x38,0xFC,0xFC,0x38,0x00,0x00,0x00,0x00,0x00,0x0D,0x0D,0x00,0x00,0x00},  /* ! */
    {0x00,0x0E,0x1E,0x00,0x00,0x1E,0x0E,0x00,0x00,0x00,0x00,0x00,0x00,0x00,0x00,0x00},  /* " */
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    {0x04,0x06,0x02,0x06,0x04,0x06,0x02,0x00,0x00,0x00,0x00,0x00,0x00,0x00,0x00,0x00},  /* ~ */
};

/* 一次完整传输: 起始 + 从机地址 + 控制字节 + 数据 + 停止 */
static void OLED_WriteBytes(uint8_t ctrl, const uint8_t *data, uint16_t len)
{
    I2C_Start();
    I2C_WriteByte((uint8_t)OLED_ADDR);      /* 从机地址, 写方向 */
    I2C_WriteByte(ctrl);                    /* 0x00=命令, 0x40=数据 */
    for (uint16_t i = 0; i < len; i++)
    {
        I2C_WriteByte(data[i]);
    }
    I2C_Stop();
}

/* 发送单字节命令 */
static void OLED_WriteCmd(uint8_t cmd)
{
    OLED_WriteBytes(OLED_CTRL_CMD, &cmd, 1);
}

/* 发送多字节数据(用于写GDDRAM页) */
static void OLED_WriteData(const uint8_t *data, uint16_t len)
{
    OLED_WriteBytes(OLED_CTRL_DATA, data, len);
}

/*
 * 定位到 (page, col) : page 0~7, col 0~127 (像素坐标, 非字符坐标)
 * 页寻址模式下: 先设页, 再设列地址的高/低字节
 */
static void OLED_SetPos(uint8_t page, uint8_t col)
{
    OLED_WriteCmd(0xB0 + page);                    /* 设页 */
    OLED_WriteCmd(0x00 + (col & 0x0F));            /* 列地址低4位 */
    OLED_WriteCmd(0x10 + ((col >> 4) & 0x0F));     /* 列地址高4位 */
}

/* 初始化 OLED */
void OLED_Init(void)
{
    I2C_Bus_Init();

    for (uint16_t i = 0; i < sizeof(OLED_INIT_CMDS); i++)
    {
        OLED_WriteCmd(OLED_INIT_CMDS[i]);
    }
    OLED_Clear();
}

/* 清屏: 8页, 每页128列写0x00 */
void OLED_Clear(void)
{
    uint8_t buf[128];
    memset(buf, 0x00, sizeof(buf));
    for (uint8_t page = 0; page < 8; page++)
    {
        OLED_SetPos(page, 0);
        OLED_WriteData(buf, sizeof(buf));
    }
}

/* 显示单个8x16字符: row=0~3(行), col=0~15(列) */
void OLED_ShowChar(uint8_t row, uint8_t col, char ch)
{
    if (row >= OLED_ROW_NUM || col >= OLED_COL_NUM) return;   /* 越界忽略 */

    uint16_t idx = (uint16_t)(uint8_t)ch;
    if (idx < 0x20) idx = 0x20;                 /* 不可见字符归一为空格 */
    if (idx >= 0x7F) idx = 0x20;                /* 只支持到 '~' */

    uint8_t col8 = col * 8;                     /* 字符首列像素坐标 */
    const uint8_t *f = FONT_8x16[idx - 0x20];

    /* 上半页: row*2 页, 写8字节(8列的上半8行) */
    OLED_SetPos(row * 2, col8);
    OLED_WriteData(f, 8);

    /* 下半页: row*2+1 页 */
    OLED_SetPos(row * 2 + 1, col8);
    OLED_WriteData(f + 8, 8);
}

/* 显示字符串, 自动逐字符横向排列 */
void OLED_ShowString(uint8_t row, uint8_t col, const char *str)
{
    while (*str && col < OLED_COL_NUM)
    {
        OLED_ShowChar(row, col, *str);
        str++;
        col++;
    }
}

/* 显示有符号整数(自动加正负号), 如 123 / -45
 * 说明: 手写整数转ASCII, 不依赖 sprintf/stdio, 节省Flash */
void OLED_ShowNum(uint8_t row, uint8_t col, int32_t num)
{
    char buf[12];
    uint8_t pos = 0;

    /* 处理负号 */
    if (num < 0)
    {
        buf[pos++] = '-';
        num = -num;
    }

    /* 至少显示一位 '0', 用倒序存数字再翻转 */
    uint8_t digits[10];
    uint8_t cnt = 0;
    do
    {
        digits[cnt++] = (uint8_t)(num % 10);
        num /= 10;
    } while (num > 0);

    while (cnt > 0)
    {
        buf[pos++] = (char)('0' + digits[cnt - 1]);
        cnt--;
    }
    buf[pos] = '\0';

    OLED_ShowString(row, col, buf);
}

/*
 * 显示一整行: 16个8x16字符正好占满128列
 *
 * 相比 OLED_ShowString 逐字符写(每字符两次定位, 每次定位3条命令),
 * 这里把整行的上半页拼成128字节、下半页拼成128字节, 各一次连写。
 * 页寻址模式下页内列地址自增, 但不会跨页, 所以两页要各设一次位置。
 *
 * 缓冲先清零再填: 空字模就是空格, 短字符串后面自动补白,
 * 上一帧多出来的字符会被一起覆盖 —— 这是不用先清屏也不残留的原因。
 *
 * 缓冲用 static: 屏只由显示任务独占访问, 不需要可重入, 这样省下 256 字节栈。
 */
void OLED_ShowLine(uint8_t row, const char *str)
{
    static uint8_t s_top[OLED_COL_NUM * 8];
    static uint8_t s_bot[OLED_COL_NUM * 8];
    uint8_t col = 0;

    if (row >= OLED_ROW_NUM) return;

    memset(s_top, 0x00, sizeof(s_top));
    memset(s_bot, 0x00, sizeof(s_bot));

    while (str[col] != '\0' && col < OLED_COL_NUM)
    {
        uint16_t idx = (uint16_t)(uint8_t)str[col];
        if (idx < 0x20) idx = 0x20;                 /* 不可见字符归一为空格 */
        if (idx >= 0x7F) idx = 0x20;                /* 只支持到 '~' */

        memcpy(&s_top[col * 8], FONT_8x16[idx - 0x20], 8);
        memcpy(&s_bot[col * 8], FONT_8x16[idx - 0x20] + 8, 8);
        col++;
    }

    OLED_SetPos(row * 2, 0);
    OLED_WriteData(s_top, sizeof(s_top));

    OLED_SetPos(row * 2 + 1, 0);
    OLED_WriteData(s_bot, sizeof(s_bot));
}
